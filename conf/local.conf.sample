## conf/local.conf.sample
```bitbake
# Local configuration for meta-rpi images
# Yocto Project 2.2 Poky distribution [morty] branch
# This is a sysvinit system

LICENSE_FLAGS_WHITELIST = "commercial"

DISTRO_FEATURES = "ext2 pam opengl usbhost ${DISTRO_FEATURES_LIBC}"

DISTRO_FEATURES_BACKFILL_CONSIDERED += "pulseaudio"

PREFERRED_PROVIDER_jpeg = "libjpeg-turbo"
PREFERRED_PROVIDER_jpeg-native = "libjpeg-turbo-native"

PREFERRED_PROVIDER_udev = "eudev"
VIRTUAL_RUNTIME_init_manager = "sysvinit"

MACHINE_FEATURES_remove = "apm"

IMAGE_FSTYPES = "tar.xz"

PREFERRED_VERSION_linux-raspberrypi = "4.4.%"

MACHINE = "raspberrypi3"

DL_DIR ?= "${TOPDIR}/downloads"

#SSTATE_DIR = "${TOPDIR}/sstate-cache"

#TMPDIR = "${TOPDIR}/tmp-morty"

DISTRO = "poky"

PACKAGE_CLASSES = "package_ipk"

DISABLE_OVERSCAN = "1"
DISPMANX_OFFLINE = "1"
ENABLE_UART = "1"
ENABLE_RPI3_SERIAL_CONSOLE = "1"

# i686 or x86_64
SDKMACHINE = "x86_64"

EXTRA_IMAGE_FEATURES = "debug-tweaks"

USER_CLASSES = "image-mklibs image-prelink"

PATCHRESOLVE = "noop"

RM_OLD_IMAGE = "1"

CONF_VERSION = "1"

########### see http://git.yoctoproject.org/cgit/cgit.cgi/meta-raspberrypi/tree/README

BB_NUMBER_THREADS ?= "4"
PARALLEL_MAKE ?= "-j 4"

GPU_MEM = "128"
VIDEO_CAMERA = "1"
ENABLE_SPI_BUS = "1"
ENABLE_I2C = "1"

DISTRO_FEATURES_remove += " x11 wayland"

IMAGE_INSTALL_append += " cpufrequtils htop strace perf setserial"
IMAGE_INSTALL_append += " packagegroup-rpi-test"
IMAGE_INSTALL_append += " gstreamer1.0-omx bluez5 lighttpd php"
IMAGE_INSTALL_append += " hostapd dnsmasq iptables rfkill"
IMAGE_INSTALL_append += " v4l-utils yavta"
```
